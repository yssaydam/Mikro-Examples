list p=16F877
INCLUDE<P16F877.INC>
__config H'3F31'

SAYI1  	EQU	0X22
SAYI2	EQU	0X23
SONUCH	EQU	0X24
SONUCL	EQU	0X25

	ORG		0X000
	GOTO	SETUP

	ORG		0X004

SETUP

	BANKSEL	ADCON1
	MOVLW	0X06
	MOVWF	ADCON1

	BANKSEL	TRISA
	BSF		TRISA,0

	CLRF	TRISB
	BANKSEL	PORTA
	CLRF	PORTA
	CLRF	PORTB
	CLRF	SAYI1
	CLRF	SAYI2
	CLRF	SONUCH
	CLRF	SONUCL

	MOVLW	D'98'
	MOVWF	SAYI1
	MOVLW	D'56'
	MOVWF	SAYI2

START

	MOVF	SAYI1,W
	ADDWF	SONUCL,F
	BTFSC	STATUS,C
	INCF	SONUCH
	DECFSZ	SAYI2,F
	GOTO	START
	
CONTROL

	BTFSC	PORTA,0
	GOTO	H_LED
	BTFSS	PORTA,0
	GOTO	L_LED
	GOTO	CONTROL

H_LED

	MOVF	SONUCH,W
	MOVWF	PORTB
	GOTO	CONTROL

L_LED

	MOVF	SONUCL,W
	MOVWF	PORTB
	GOTO	CONTROL		

END