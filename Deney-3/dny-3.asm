list p=16F877
INCLUDE <P16F877.INC>
__config H'3F31'

COUNTER		EQU	0X22
REFERENCE	EQU	0X23

COUNTER2	EQU	0X24
COUNTER3	EQU	0X25

SAYI1		EQU	0X26
SAYI2		EQU	0X27		

	ORG 	0X00
	GOTO 	SETUP

	ORG 	0X04
	GOTO	INTERRUPT

INTERRUPT

	BTFSS	PIR1,TMR1IF
RETFIE
	BCF		PIR1,TMR1IF
	
	BANKSEL	TMR1H

	MOVLW	0X3C
	MOVWF	TMR1H
	MOVLW	0XB0
	MOVWF	TMR1L
	DECFSZ	COUNTER,1
RETFIE
	MOVLW	0X0A
	MOVWF	COUNTER
;<------------------->
	INCF 	SAYI2,F	
	MOVLW 	0X0A
	SUBWF 	SAYI2,W
	BTFSS	STATUS,Z
RETFIE
	CLRF	SAYI2
	INCF	SAYI1
	MOVLW 	0X06
	SUBWF 	SAYI1,W
	BTFSC 	STATUS,Z
	CLRF 	SAYI1
	CLRF	SAYI2
RETFIE
;<------------------->

	
SETUP
	
	BANKSEL	ADCON1
	MOVLW	0X06
	MOVWF	ADCON1

	BANKSEL	TRISB
	CLRF	TRISA
	CLRF	TRISB
	BANKSEL	PORTB
	CLRF	PORTA
	CLRF	PORTB

	BANKSEL	INTCON
	BSF		INTCON,GIE
	BSF		INTCON,PEIE

	BANKSEL	PIE1
	BSF		PIE1,TMR1IE

	BANKSEL	TMR1H
	MOVLW	0X3C
	MOVWF	TMR1H
	MOVLW	0XB0
	MOVWF	TMR1L

	BANKSEL	T1CON
	MOVLW	B'00010001'
	MOVWF	T1CON

	BANKSEL	COUNTER
	MOVLW	0x0A
	MOVWF	COUNTER

	CLRF SAYI1
	CLRF SAYI2

MAIN

	BCF		PORTA,1	    
	MOVF	SAYI1,W	    
	CALL	LOOKUP	    
	BSF		PORTA,0	    
	MOVWF	PORTB	    
	CALL	DELAY	
	CLRF	PORTB	    
;>------------------------<
	BCF		PORTA,0	    
	MOVF	SAYI2,W	    
	CALL	LOOKUP	    
	BSF		PORTA,1	    
	MOVWF	PORTB	    
	CALL	DELAY
	CLRF	PORTB	    

	GOTO MAIN

LOOKUP
    ADDWF   PCL,F
    RETLW   B'00111111' 
    RETLW   B'00000110' 
    RETLW   B'01011011' 
    RETLW   B'01001111' 
    RETLW   B'01100110' 
    RETLW   B'01101101' 
    RETLW   B'01111101' 
    RETLW   B'00000111' 
    RETLW   B'01111111'
	RETLW   B'01101111'

DELAY
	
	MOVLW	0X10	
	MOVWF	COUNTER2

D1	
	
	MOVLW	0X10
	MOVWF	COUNTER3

D2
	
	DECFSZ	COUNTER3
	GOTO	D2
	DECFSZ	COUNTER2
	GOTO	D1
	RETURN
	
END