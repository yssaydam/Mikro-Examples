LIST P=16F877A
#include<p16f877a.inc>
__config H'3F31'

COUNTER		EQU	0X22
COUNTER2	EQU	0X23

	ORG		0X000
	GOTO	SETUP1
	
SETUP1

	BANKSEL	ADCON1
	MOVLW	0X06
	MOVWF	ADCON1
	
	BANKSEL	TRISA
	MOVLW	0XFF
	MOVWF	TRISA
	CLRF	TRISC
	
	BANKSEL	PORTA
	CLRF	PORTA
	CLRF	PORTC

	GOTO	PWM_ON

SETUP2

	BANKSEL	PR2
	MOVLW	0X18 ;D'24'
	MOVWF	PR2

	BANKSEL	CCPR1L	
	MOVLW	0X19 ;D'25' 
	MOVWF	CCPR1L	
	MOVWF	CCPR2L

	BANKSEL	CCP1CON
	MOVLW	B'00001100' ; 
	MOVWF	CCP1CON
	MOVWF	CCP2CON

	BANKSEL	T2CON
	MOVLW	0X05  ;B'00000101' PS -> 4
	MOVWF	T2CON

LOOP

	BTFSC	PORTA,0 ;PWM ON
	CALL	PWM_ON
	BTFSC	PORTA,1 ;PWM OFF
	CALL	PWM_OFF
	BTFSC	PORTA,2	;LED_INC
	CALL	LED_INC
	BTFSC	PORTA,3	;LED_DEC
	CALL	LED_DEC
	BTFSC	PORTA,4	;ENGINE_INC
	CALL	ENGINE_INC
	BTFSC	PORTA,5	;ENGINE_DEC
	CALL	ENGINE_DEC

	GOTO	LOOP

PWM_ON

	BTFSC	PORTA,0
	GOTO	SETUP2
	GOTO	PWM_ON

PWM_OFF

	BANKSEL	T2CON
	CLRF	T2CON
	CLRF	CCP1CON
	CLRF	CCP2CON
	CALL	DELAY
	RETURN

LED_INC

	MOVLW 	D'25'
  	SUBWF 	CCPR2L,W
  	BTFSC 	STATUS,Z
  	RETURN
  	MOVLW	D'5'
  	ADDWF	CCPR2L,F
  	CALL 	DELAY

	RETURN

LED_DEC

	MOVLW 	D'0'
  	SUBWF 	CCPR2L,W
  	BTFSC 	STATUS,Z
  	RETURN
  	MOVLW 	D'5'
  	SUBWF 	CCPR2L,F
  	CALL 	DELAY

	RETURN

ENGINE_INC

	MOVLW 	D'25'
  	SUBWF 	CCPR1L,W
  	BTFSC 	STATUS,Z
  	RETURN
  	MOVLW	D'5'
  	ADDWF	CCPR1L,F
  	CALL 	DELAY

	RETURN

ENGINE_DEC

	MOVLW 	D'0'
  	SUBWF 	CCPR1L,W
  	BTFSC 	STATUS,Z
  	RETURN
  	MOVLW 	D'5'
  	SUBWF 	CCPR1L,F
  	CALL 	DELAY

	RETURN
	
DELAY
	MOVLW	0XFF
	MOVWF	COUNTER
	
D1
	MOVLW	0XFF
	MOVWF	COUNTER2

D2
	DECFSZ	COUNTER2
	GOTO	D2
	DECFSZ	COUNTER
	GOTO	D1
	RETURN

END